VERSION ""

NS_ :

BS_:

BU_: XXX

BO_ 380 Car_Motion: 8 XXX
 SG_ RPM_probably : 23|16@0+ (1,0) [0|65535] "rpm" XXX
 SG_ Gas_Pressed_probably : 39|1@0+ (1,0) [0|1] "" XXX

BO_ 356 NEW_MSG_1: 8 XXX

BO_ 432 NEW_MSG_2: 8 XXX

BO_ 476 NEW_MSG_3: 8 XXX

BO_ 464 NEW_MSG_4: 8 XXX

BO_ 344 NEW_MSG_5: 8 XXX
 SG_ Brake_pressed_possibly : 33|1@0+ (1,0) [0|1] "" XXX
